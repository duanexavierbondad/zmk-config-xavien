## boards/shields/xavien/Kconfig.defconfig
```kconfig
# Copyright (c) 2020 The ZMK Contributors
# SPDX-License-Identifier: MIT

if SHIELD_XAVIEN_DONGLE || SHIELD_XAVIEN_DONGLE_XIAO || SHIELD_XAVIEN_LEFT-MASTER || SHIELD_XAVIEN_RIGHT-MASTER

config ZMK_KEYBOARD_NAME
	default "XAVIEN"
	
config ZMK_SPLIT_BLE_ROLE_CENTRAL
	default y
	
config ZMK_USB
	default y

endif

if SHIELD_XAVIEN_LEFT || SHIELD_XAVIEN_RIGHT || SHIELD_XAVIEN_DONGLE || SHIELD_XAVIEN_DONGLE_XIAO || SHIELD_XAVIEN_LEFT-MASTER || SHIELD_XAVIEN_RIGHT-MASTER

config ZMK_SPLIT
	default y

config ZMK_BLE
	default y

endif
```
